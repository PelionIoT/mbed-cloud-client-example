## west.yml
```yaml
manifest:
  self:
    path: izuma-dm-example
  remotes:
    - name: PelionIoT
      url-base: https://github.com/PelionIoT
    - name: zephyrproject-rtos
      url-base: https://github.com/zephyrproject-rtos
  projects:
    - name: izuma-dm
      repo-path: mbed-cloud-client
      remote: PelionIoT
      revision: 538894319985f79777df358f27f8315f60749801
      path: modules/lib/izuma-dm
    - name: zephyr
      remote: zephyrproject-rtos
      revision: v3.6.0
      import: true
```
