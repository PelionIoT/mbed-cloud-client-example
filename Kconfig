## Kconfig
```kconfig
# Copyright (c) 2022 Izuma Networks
# SPDX-License-Identifier: Apache-2.0

menu "Izuma Device Management Client Example"

comment "    Example application configuration                         "

config IZUMA_EXAMPLE_DEVELOPER_MODE
    bool "Enable developer mode to skip Factory enrollment"
    default y
    help
      Connect to Izuma DM using developer credentials.

comment "    Library configuration can be found under:                 "
comment "        Modules -> Izuma Device Management Client Library    "

endmenu

source "Kconfig.zephyr"
```
